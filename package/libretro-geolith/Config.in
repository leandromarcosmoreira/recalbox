## package/libretro-geolith/Config.in
```kconfig
config BR2_PACKAGE_LIBRETRO_GEOLITH
	bool "libretro-geolith"
	depends on BR2_PACKAGE_RETROARCH
	depends on BR2_INSTALL_LIBSTDCPP
	help
	  Geolith is a highly accurate Neo Geo AES/MVS emulator

	  https://github.com/libretro/geolith-libretro

comment "LIBRETRO_GEOLITH needs a toolchain w/ C++"
	depends on !BR2_INSTALL_LIBSTDCPP
```

## package/retroarch/Config.in
```kconfig
config BR2_PACKAGE_RETROARCH
	bool "Retroarch"
	depends on BR2_PACKAGE_RECALBOX_SYSTEM
	select BR2_PACKAGE_NANOARCH
	select BR2_PACKAGE_RETROARCH_ASSETS
	select BR2_PACKAGE_FLAC
	select BR2_PACKAGE_XSERVER_XORG_SERVER if BR2_PACKAGE_RECALBOX_VIDEO_XORG_SERVER
	select BR2_PACKAGE_XWAYLAND if BR2_PACKAGE_RECALBOX_VIDEO_XWAYLAND
	help
	  A multi emulator frontend.

	  http://www.libretro.com

comment "Retroarch depends on EGL or OpenGLES"
	depends on !(BR2_PACKAGE_HAS_LIBEGL || BR2_PACKAGE_HAS_LIBGLES || BR2_PACKAGE_HAS_LIBGL)
```

## package/vvvvvv/Config.in
```kconfig
config BR2_PACKAGE_VVVVVV
	bool "vvvvvv"
	help
	  The source code to VVVVVV!
	  https://github.com/TerryCavanagh/VVVVVV
```

## package/wii-u-gc-adapter/Config.in
```kconfig
config BR2_PACKAGE_WII_U_GC_ADAPTER
	bool "wii-u-gc-adapter"
	help
	  Tool for using the Wii U GameCube Adapter on Linux
```
