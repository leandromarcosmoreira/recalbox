## package/kodi-plugin-video-freebox/Config.in
```kconfig
config BR2_PACKAGE_KODI_PLUGIN_VIDEO_FREEBOX
	bool "kodi-plugin-video-netflix"
	default y
	depends on BR2_PACKAGE_KODI
	help
	  Kodi + Freebox TV

	  https://github.com/aassif/pvr.freebox
```

## package/libretro-b2/Config.in
```kconfig
config BR2_PACKAGE_LIBRETRO_B2
	bool "libretro-b2"
	depends on BR2_PACKAGE_RETROARCH
	depends on BR2_INSTALL_LIBSTDCPP
	help
	  Libretro b2 core - A BBC Micro emulator

	  https://github.com/zoltanvb/b2-libretro

comment "LIBRETRO_B2 needs a toolchain w/ C++"
	depends on !BR2_INSTALL_LIBSTDCPP
```

## package/wlr-randr/Config.in
```kconfig
config BR2_PACKAGE_WLR_RANDR
	bool "wlr-randr"
	depends on BR2_PACKAGE_DWL
	# Runtime dependencies
	help
	  wlr-randr allow to change dwl resolution

	  https://github.com/emersion/wlr-randr
```
